#include "stm32f4xx.h"
#include "hal_rcc.h"

void RCC_Init()
{
    // MCO1 out for debug
    // SET_BIT(RCC->CFGR, RCC_CFGR_MCO1_0);
    // SET_BIT(RCC->CFGR, RCC_CFGR_MCO1_1);
    // SET_BIT(RCC->CFGR, RCC_CFGR_MCO1PRE_0);
    // SET_BIT(RCC->CFGR, RCC_CFGR_MCO1PRE_1);
    // SET_BIT(RCC->CFGR, RCC_CFGR_MCO1PRE_2);

    // 外部高速时钟使能
    SET_BIT(RCC->CR, RCC_CR_HSEON);
    while (!READ_BIT(RCC->CR, RCC_CR_HSERDY))
        ;
    // 需要清零寄存器，有些位有初始值
    // WRITE_REG(RCC->PLLCFGR, 0);
    // pll分频设置
    WRITE_BIT(RCC->PLLCFGR, RCC_PLLCFGR_PLLM, 25);   // M
    WRITE_BIT(RCC->PLLCFGR, RCC_PLLCFGR_PLLN, 168); // N
    CLEAR_BIT(RCC->PLLCFGR, RCC_PLLCFGR_PLLP_0);   // P
    CLEAR_BIT(RCC->PLLCFGR, RCC_PLLCFGR_PLLP_0);   // P
    WRITE_BIT(RCC->PLLCFGR, RCC_PLLCFGR_PLLQ, 4);   // Q

    SET_BIT(RCC->PLLCFGR, RCC_PLLCFGR_PLLSRC_HSE);

    SET_BIT(RCC->CFGR, RCC_CFGR_HPRE_DIV1);
    SET_BIT(RCC->CFGR, RCC_CFGR_PPRE1_DIV2);
    SET_BIT(RCC->CFGR, RCC_CFGR_PPRE2_DIV1);

    // PLL ON
    SET_BIT(RCC->CR, RCC_CR_PLLON);
    while (!READ_BIT(RCC->CR, RCC_CR_PLLRDY))
        ;
    // SYSCLK switch to PLL
    SET_BIT(RCC->CFGR, RCC_CFGR_SW_PLL);
    // wait for SYSCLK switch to PLL
    while (!(RCC->CFGR & RCC_CFGR_SWS_PLL))
        ;
    // 打开gpio A C D E F G H I的时钟
    SET_BIT(RCC->AHB1ENR, RCC_AHB1ENR_GPIOAEN);
    SET_BIT(RCC->AHB1ENR, RCC_AHB1ENR_GPIOBEN);
    SET_BIT(RCC->AHB1ENR, RCC_AHB1ENR_GPIOCEN);
    SET_BIT(RCC->AHB1ENR, RCC_AHB1ENR_GPIODEN);
    SET_BIT(RCC->AHB1ENR, RCC_AHB1ENR_GPIOEEN);
    // SET_BIT(RCC->AHB1ENR, RCC_AHB1ENR_GPIOFEN);
    // SET_BIT(RCC->AHB1ENR, RCC_AHB1ENR_GPIOGEN);
    SET_BIT(RCC->AHB1ENR, RCC_AHB1ENR_GPIOHEN);
    // SET_BIT(RCC->AHB1ENR, RCC_AHB1ENR_GPIOIEN);
    // 打开USART1的时钟
    SET_BIT(RCC->APB2ENR, RCC_APB2ENR_USART1EN);
    // 打开SPI1的时钟
    SET_BIT(RCC->APB2ENR, RCC_APB2ENR_SPI1EN);
}